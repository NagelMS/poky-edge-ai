## meta-mytraffic-app/conf/layer.conf
```bitbake
BBPATH .= ":${LAYERDIR}"

# We have recipes-* directories, add to BBFILES
BBFILES += "${LAYERDIR}/recipes-*/*/*.bb \
            ${LAYERDIR}/recipes-*/*/*.bbappend"

BBFILE_COLLECTIONS += "meta-mytraffic-app"
BBFILE_PATTERN_meta-mytraffic-app = "^${LAYERDIR}/"
BBFILE_PRIORITY_meta-mytraffic-app = "6"

LAYERDEPENDS_meta-mytraffic-app = "core"
LAYERSERIES_COMPAT_meta-mytraffic-app = "kirkstone"
```
